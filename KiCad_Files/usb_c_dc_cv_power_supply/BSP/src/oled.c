/*
 * oled.c
 *
 *  Created on: Nov 5, 2025
 *      Author: Ahasas
 */
#include "oled.h"
#include "string.h"
#include "stdio.h"

extern I2C_HandleTypeDef hi2c1;

// Display buffer (1024 bytes)
static uint8_t buffer[SSD1306_WIDTH * SSD1306_HEIGHT / 8];

// Basic 6x8 font
static const uint8_t Font6x8[][6] = {
		{0x00,0x00,0x00,0x00,0x00,0x00}, // 32
		{0x00,0x00,0x5F,0x00,0x00,0x00}, // 33 !
		{0x00,0x07,0x00,0x07,0x00,0x00}, // 34 "
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		{0x7F,0x41,0x41,0x41,0x7F,0x00}  // 127 DEL (filled box)
};


// Send command
static void SSD1306_Cmd(uint8_t cmd)
{
    uint8_t d[2] = {0x00, cmd};
    HAL_I2C_Master_Transmit(&hi2c1, SSD1306_I2C_ADDR << 1, d, 2, HAL_MAX_DELAY);
}

// Send data block
static void SSD1306_Data(uint8_t *data, uint16_t size)
{
    uint8_t control = 0x40;
    HAL_I2C_Mem_Write(&hi2c1, SSD1306_I2C_ADDR << 1,
                      control, I2C_MEMADD_SIZE_8BIT,
                      data, size, HAL_MAX_DELAY);
}

void SSD1306_Init(void)
{
    HAL_Delay(100);

    SSD1306_Cmd(0xAE);
    SSD1306_Cmd(0x20); SSD1306_Cmd(0x00);
    SSD1306_Cmd(0xB0);
    SSD1306_Cmd(0xC8);
    SSD1306_Cmd(0x00);
    SSD1306_Cmd(0x10);
    SSD1306_Cmd(0x40);
    SSD1306_Cmd(0x81); SSD1306_Cmd(0xFF);
    SSD1306_Cmd(0xA1);
    SSD1306_Cmd(0xA6);
    SSD1306_Cmd(0xA8); SSD1306_Cmd(0x3F);
    SSD1306_Cmd(0xA4);
    SSD1306_Cmd(0xD3); SSD1306_Cmd(0x00);
    SSD1306_Cmd(0xD5); SSD1306_Cmd(0xF0);
    SSD1306_Cmd(0xD9); SSD1306_Cmd(0x22);
    SSD1306_Cmd(0xDA); SSD1306_Cmd(0x12);
    SSD1306_Cmd(0xDB); SSD1306_Cmd(0x20);
    SSD1306_Cmd(0x8D); SSD1306_Cmd(0x14);
    SSD1306_Cmd(0xAF);

    SSD1306_Clear();
    SSD1306_Update();
}

void SSD1306_Clear(void)
{
    memset(buffer, 0x00, sizeof(buffer));
}

void SSD1306_Update(void)
{
    for (uint8_t page = 0; page < 8; page++)
    {
        SSD1306_Cmd(0xB0 + page);
        SSD1306_Cmd(0x00);
        SSD1306_Cmd(0x10);
        SSD1306_Data(&buffer[SSD1306_WIDTH * page], SSD1306_WIDTH);
    }
}

// Draw 6×8 character
static void SSD1306_DrawChar(uint8_t x, uint8_t y, char c)
{
    if (c < 32 || c > 127) return;

    const uint8_t *glyph = Font6x8[c - 32];

    for (uint8_t col = 0; col < 6; col++)
    {
        uint8_t line = glyph[col];
        for (uint8_t row = 0; row < 8; row++)
        {
            uint8_t pixel = (line >> row) & 1;

            if (pixel)
                buffer[x + col + (y + row)/8 * SSD1306_WIDTH] |=  (1 << ((y + row) % 8));
            else
                buffer[x + col + (y + row)/8 * SSD1306_WIDTH] &= ~(1 << ((y + row) % 8));
        }
    }
}

void SSD1306_Print(uint8_t x, uint8_t y, char *str)
{
    while (*str)
    {
        SSD1306_DrawChar(x, y, *str);
        x += 6;
        str++;
    }
}

void SSD1306_PrintNumber(uint8_t x, uint8_t y, int num)
{
    char buf[12];
    sprintf(buf, "%d", num);
    SSD1306_Print(x, y, buf);
}

void SSD1306_SetPixel(uint8_t x, uint8_t y, uint8_t color)
{
    if (x >= SSD1306_WIDTH || y >= SSD1306_HEIGHT) return;

    uint16_t index = x + (y / 8) * SSD1306_WIDTH;

    if (color)
        buffer[index] |=  (1 << (y % 8));
    else
        buffer[index] &= ~(1 << (y % 8));
}


void SSD1306_DrawChar2X(uint8_t x, uint8_t y, char c)
{
    if (c < 32 || c > 127) return;

    const uint8_t *glyph = Font6x8[c - 32];

    for (uint8_t col = 0; col < 6; col++)
    {
        uint8_t line = glyph[col];

        for (uint8_t row = 0; row < 8; row++)
        {
            uint8_t pixel = (line >> row) & 1;

            uint8_t drawX = x + (col * 2);
            uint8_t drawY = y + (row * 2);

            if (pixel)
            {
                // draw 2×2 block
                SSD1306_SetPixel(drawX,     drawY,     1);
                SSD1306_SetPixel(drawX + 1, drawY,     1);
                SSD1306_SetPixel(drawX,     drawY + 1, 1);
                SSD1306_SetPixel(drawX + 1, drawY + 1, 1);
            }
        }
    }
}

void SSD1306_Print2X(uint8_t x, uint8_t y, char *str)
{
    while (*str)
    {
        SSD1306_DrawChar2X(x, y, *str);
        x += 12;   // because 6px → 12px
        str++;
    }
}

void SSD1306_DrawChar15X(uint8_t x, uint8_t y, char c)
{
    if (c < 32 || c > 127) return;

    const uint8_t *glyph = Font6x8[c - 32];

    // X scaling pattern: 1.5x => columns expanded as 2,1,2,1,2,1
    const uint8_t scaleX[6] = {2,1,2,1,2,1};

    // Y scaling pattern: 2,1,2,1,2,1,2,1
    const uint8_t scaleY[8] = {2,1,2,1,2,1,2,1};

    uint8_t xx = x;

    for (uint8_t col = 0; col < 6; col++)
    {
        uint8_t line = glyph[col];
        uint8_t w = scaleX[col];   // width for this column

        uint8_t yy = y;

        for (uint8_t row = 0; row < 8; row++)
        {
            uint8_t h = scaleY[row];    // height for this row
            uint8_t pixel = (line >> row) & 1;

            if (pixel)
            {
                for (uint8_t dx = 0; dx < w; dx++)
                {
                    for (uint8_t dy = 0; dy < h; dy++)
                    {
                        SSD1306_SetPixel(xx + dx, yy + dy, 1);
                    }
                }
            }

            yy += h;   // move down scaled amount
        }

        xx += w;       // move right scaled amount
    }
}

void SSD1306_Print15X(uint8_t x, uint8_t y, char *str)
{
    while (*str)
    {
        SSD1306_DrawChar15X(x, y, *str);
        x += 9;   // approx width of 1.5x character
        str++;
    }
}

